## buildroot/package/simpleaudio-alsa-utils/Config.in
```kconfig
config BR2_PACKAGE_SIMPLEAUDIO_ALSA_UTILS
    bool "simpleaudio-alsa-utils"
    help
      Enable Simpleaudio ALSA-UTILS package.
```

## buildroot/package/simpleaudio-alsa/Config.in
```kconfig
config BR2_PACKAGE_SIMPLEAUDIO_ALSA
    bool "simpleaudio-alsa"
    help
      Enables Simpleaudio ALSA package.
```

## buildroot/package/simpleaudio-control/Config.in
```kconfig
config BR2_PACKAGE_SIMPLEAUDIO_CONTROL
    bool "simpleaudio-control"
    help
      Installs Simpleaudio control panel in Beocreate2.
```

## buildroot/package/simpleaudio-gpio-tools/Config.in
```kconfig
config BR2_PACKAGE_SIMPLEAUDIO_GPIO_TOOLS
    bool "simpleaudio-gpio-tools"
    help
      Installs Simpleaudio GPIO tools to the rootfs.
```

## buildroot/package/simpleaudio-tools/Config.in
```kconfig
config BR2_PACKAGE_SIMPLEAUDIO_TOOLS
    bool "simpleaudio-tools"
    help
      Installs Simpleaudio tools to the Roomplayer.
```

## buildroot/package/simpleaudio-updater/Config.in
```kconfig
config BR2_PACKAGE_SIMPLEAUDIO_UPDATER
    bool "simpleaudio-updater"
    help
      Installs Simpleaudio updater to the Beocreate UI.
```
